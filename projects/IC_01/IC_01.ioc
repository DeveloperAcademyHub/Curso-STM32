# file: IC_01.ioc
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Mcu.Family=STM32G4
Mcu.Name=STM32G474R(B-C-E)Tx
Mcu.Package=LQFP64
NVIC.PriorityGroup=NVIC_PRIORITYGROUP_4
NVIC.TIM2_IRQn=true\:0\:0\:false\:false\:true\:true\:true\:true
PA0.Signal=S_TIM2_CH1
ProjectManager.HeapSize=0x200
ProjectManager.StackSize=0x400
ProjectManager.TargetToolchain=STM32CubeIDE
RCC.ADC12Freq_Value=16000000
RCC.ADC345Freq_Value=16000000
RCC.AHBFreq_Value=16000000
RCC.APB1Freq_Value=16000000
RCC.APB1TimFreq_Value=16000000
RCC.APB2Freq_Value=16000000
RCC.APB2TimFreq_Value=16000000
RCC.CortexFreq_Value=16000000
RCC.EXTERNAL_CLOCK_VALUE=12288000
RCC.HCLKFreq_Value=16000000
RCC.HSE_VALUE=24000000
RCC.HSI48_VALUE=48000000
RCC.HSI_VALUE=16000000
RCC.LSE_VALUE=32768
RCC.PLLM=RCC_PLLM_DIV4
RCC.PLLN=85
RCC.RTCClockSelection=RCC_RTCCLKSOURCE_LSE
RCC.SYSCLKFreq_VALUE=16000000
RCC.USBFreq_Value=170000000
RCC.VCOOutputFreq_Value=340000000
SH.S_TIM2_CH1.0=TIM2_CH1,Input_Capture1_from_TI1
TIM2.Channel-Input_Capture1_from_TI1=TIM_CHANNEL_1
TIM2.ICPolarity_CH1=TIM_INPUTCHANNELPOLARITY_BOTHEDGE
TIM2.PeriodNoDither=65535
TIM2.Prescaler=8-1
VP_SYS_VS_DBSignals.Mode=DisableDeadBatterySignals
VP_TIM2_VS_ClockSourceINT.Mode=Internal
board=NUCLEO-G474RE

// file: Core/Src/main.c
/* USER CODE BEGIN Header */
/**
  ******************************************************************************
  * @file           : main.c
  * @brief          : Main program body
  ******************************************************************************
  * @attention
  *
  * Copyright (c) 2026 STMicroelectronics.
  * All rights reserved.
  *
  * This software is licensed under terms that can be found in the LICENSE file
  * in the root directory of this software component.
  * If no LICENSE file comes with this software, it is provided AS-IS.
  *
  ******************************************************************************
	Hardware: NUCLEO-G474RE
	Objetivo: Capiturar um sinal em um dos canais do timer (Input capture direct mode) para calcular seu periodo/frequencia.

	Notas: TIM2 (CH1 -> PA0)

		Clock APB: 16 MHz
			Alvo de 2 MHz: O objetivo é que o timer incremente seu contador exatamente 2 milhão de vezes por segundo.

		Prescaler (PSC): f_CNT = f_TIM_CLK/(PSC+1)
			Para transformar 16 MHz em 2 MHz, dividimos por 8.
			Valor no registrador do PSC: 8−1

		Agora, cada "passo" (tick) do timer dura exatamente 2μs.

		Valor no registrador do ARR: 65535

		Frequencia minima = f_time / ARR = 2M/65535 = 30Hz

  */

/* USER CODE END Header */
#include "main.h"

/* USER CODE BEGIN Includes */
int32_t leitura[3];
int32_t frequencia;
uint8_t set = 0;
/* USER CODE END Includes */

TIM_HandleTypeDef htim2;

void SystemClock_Config(void);
static void MX_GPIO_Init(void);
static void MX_TIM2_Init(void);

/* USER CODE BEGIN 0 */

// Executa essa função durante a borda de subida e a borda de decida
void HAL_TIM_IC_CaptureCallback(TIM_HandleTypeDef *htim)
{
	if(htim == &htim2){

		// Diferença das leitura
		if (set==2){
			leitura[2] = leitura[1]-leitura[0];
			// f = f_tim / dif
			frequencia = 2000000 / leitura[2];
			frequencia = frequencia/2;
			set=0;
		}

		// Leitura na borda de decida
		if(set==1){
			leitura[1] = HAL_TIM_ReadCapturedValue(&htim2, TIM_CHANNEL_1);
			set = 2;
		}

		// Leitura na borda de subida
		if(set==0){
			leitura[0] = HAL_TIM_ReadCapturedValue(&htim2, TIM_CHANNEL_1);
			set = 1;
		}

	}
}

/* USER CODE END 0 */

int main(void)
{

  /* MCU Configuration--------------------------------------------------------*/

  /* Reset of all peripherals, Initializes the Flash interface and the Systick. */
  HAL_Init();

  /* Configure the system clock */
  SystemClock_Config();

  /* Initialize all configured peripherals */
  MX_GPIO_Init();
  MX_TIM2_Init();
  /* USER CODE BEGIN 2 */

  HAL_TIM_IC_Start_IT(&htim2, TIM_CHANNEL_1); // Inicializando
  /* USER CODE END 2 */

  /* Infinite loop */
  while (1)
  {

  }
}

void SystemClock_Config(void)
{
  RCC_OscInitTypeDef RCC_OscInitStruct = {0};
  RCC_ClkInitTypeDef RCC_ClkInitStruct = {0};

  /** Configure the main internal regulator output voltage
  */
  HAL_PWREx_ControlVoltageScaling(PWR_REGULATOR_VOLTAGE_SCALE1);

  /** Initializes the RCC Oscillators according to the specified parameters
  * in the RCC_OscInitTypeDef structure.
  */
  RCC_OscInitStruct.OscillatorType = RCC_OSCILLATORTYPE_HSI;
  RCC_OscInitStruct.HSIState = RCC_HSI_ON;
  RCC_OscInitStruct.HSICalibrationValue = RCC_HSICALIBRATION_DEFAULT;
  RCC_OscInitStruct.PLL.PLLState = RCC_PLL_NONE;
  if (HAL_RCC_OscConfig(&RCC_OscInitStruct) != HAL_OK)
  {
    Error_Handler();
  }

  /** Initializes the CPU, AHB and APB buses clocks
  */
  RCC_ClkInitStruct.ClockType = RCC_CLOCKTYPE_HCLK|RCC_CLOCKTYPE_SYSCLK
                              |RCC_CLOCKTYPE_PCLK1|RCC_CLOCKTYPE_PCLK2;
  RCC_ClkInitStruct.SYSCLKSource = RCC_SYSCLKSOURCE_HSI;
  RCC_ClkInitStruct.AHBCLKDivider = RCC_SYSCLK_DIV1;
  RCC_ClkInitStruct.APB1CLKDivider = RCC_HCLK_DIV1;
  RCC_ClkInitStruct.APB2CLKDivider = RCC_HCLK_DIV1;

  if (HAL_RCC_ClockConfig(&RCC_ClkInitStruct, FLASH_LATENCY_0) != HAL_OK)
  {
    Error_Handler();
  }
}

static void MX_TIM2_Init(void)
{

  TIM_ClockConfigTypeDef sClockSourceConfig = {0};
  TIM_MasterConfigTypeDef sMasterConfig = {0};
  TIM_IC_InitTypeDef sConfigIC = {0};

  htim2.Instance = TIM2;
  htim2.Init.Prescaler = 8-1;
  htim2.Init.CounterMode = TIM_COUNTERMODE_UP;
  htim2.Init.Period = 65535;
  htim2.Init.ClockDivision = TIM_CLOCKDIVISION_DIV1;
  htim2.Init.AutoReloadPreload = TIM_AUTORELOAD_PRELOAD_DISABLE;
  if (HAL_TIM_Base_Init(&htim2) != HAL_OK)
  {
    Error_Handler();
  }
  sClockSourceConfig.ClockSource = TIM_CLOCKSOURCE_INTERNAL;
  if (HAL_TIM_ConfigClockSource(&htim2, &sClockSourceConfig) != HAL_OK)
  {
    Error_Handler();
  }
  if (HAL_TIM_IC_Init(&htim2) != HAL_OK)
  {
    Error_Handler();
  }
  sMasterConfig.MasterOutputTrigger = TIM_TRGO_RESET;
  sMasterConfig.MasterSlaveMode = TIM_MASTERSLAVEMODE_DISABLE;
  if (HAL_TIMEx_MasterConfigSynchronization(&htim2, &sMasterConfig) != HAL_OK)
  {
    Error_Handler();
  }
  sConfigIC.ICPolarity = TIM_INPUTCHANNELPOLARITY_BOTHEDGE;
  sConfigIC.ICSelection = TIM_ICSELECTION_DIRECTTI;
  sConfigIC.ICPrescaler = TIM_ICPSC_DIV1;
  sConfigIC.ICFilter = 0;
  if (HAL_TIM_IC_ConfigChannel(&htim2, &sConfigIC, TIM_CHANNEL_1) != HAL_OK)
  {
    Error_Handler();
  }

}

static void MX_GPIO_Init(void)
{

  /* GPIO Ports Clock Enable */
  __HAL_RCC_GPIOA_CLK_ENABLE();

}

void Error_Handler(void)
{
  __disable_irq();
  while (1)
  {
  }
}
